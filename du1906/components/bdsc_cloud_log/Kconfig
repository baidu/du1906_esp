## du1906/components/bdsc_dispatcher/Kconfig
```kconfig
menu "bdsc engine"

config USE_OFFLINE_DIRECTIVE
    bool "enable offline directive"

endmenu
```

## du1906/components/boards/Kconfig.projbuild
```kconfig
menu "Customer Audio Board"

choice CUSTOMER_AUDIO_BOARD
    prompt "Customer audio board"
    default CUPID_BOARD_V2
    help
        Select an audio board to use with the ESP-ADF

config CUPID_BOARD_V2
    bool "Cupid board v2.0"

config ESP32_KORVO_DU1906_BOARD
    bool "ESP32_KORVO_DU1906"

config MINI_BOARD
    bool "MINI_DU1906"

endchoice

endmenu
```

## du1906/components/music/Kconfig
```kconfig
menu "music skill"

config ENABLE_MUSIC_UNIT
    bool "enable music unit"

config MIGU_MUSIC
    depends on ENABLE_MUSIC_UNIT
    bool "migu music"

config HIMALAYA_MUSIC
    depends on ENABLE_MUSIC_UNIT
    bool "Himalaya music"

config QING_MUSIC
    depends on ENABLE_MUSIC_UNIT
    bool "qing music"

endmenu
```

## du1906/esp-adf/components/audio_board/Kconfig.projbuild
```kconfig
menu "Audio HAL"

choice ESP32_KORVO_DU1906_DAC
    prompt "ESP32 KORVO DU1906 Board DAC chip"
    default ESP32_KORVO_DU1906_CODEC_TAS5805M
    help
        Select DAC chip to use on ESP32_KORVO_DU1906 board

config ESP32_KORVO_DU1906_DAC_TAS5805M
    bool "ESP32_KORVO_DU1906_DAC_TAS5805M"
config ESP32_KORVO_DU1906_DAC_ES7148
    bool "ESP32_KORVO_DU1906_DAC_ES7148"

endchoice

choice ESP32_KORVO_DU1906_ADC
    prompt "ESP32 KORVO DU1906 Board ADC chip"
    default ESP32_KORVO_DU1906_ADC_ES7243
    help
        Select ADC chip to use on ESP32_KORVO_DU1906 board

config ESP32_KORVO_DU1906_ADC_ES7243
    bool "ESP32_KORVO_DU1906_ADC_ES7243"
endchoice

endmenu
```
